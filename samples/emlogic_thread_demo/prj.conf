## CMakeLists.txt
```
# SPDX-License-Identifier: Apache-2.0

cmake_minimum_required(VERSION 3.20.0)

find_package(Zephyr REQUIRED HINTS $ENV{ZEPHYR_BASE})
project(emlogic_thread_demo)

target_sources(app PRIVATE src/main.c)
```

## sample.yaml
```
sample:
  description:
    EmLogic thread demo application
  name: EmLogic thread demo
common:
  tags: introduction
  integration_platforms:
    - native_sim
  harness: console
  harness_config:
    type: one_line
    regex:
      - "EmLogic thread demo (.*)"
tests:
  sample.basic.emlogic_tread_demo:
    tags: introduction
```

## prj.conf
```kconfig
CONFIG_MAX_DOMAIN_PARTITIONS=16
CONFIG_USERSPACE=y
CONFIG_MAX_THREAD_BYTES=2
CONFIG_DYNAMIC_OBJECTS=y
CONFIG_EXTRA_EXCEPTION_INFO=y
CONFIG_SIMPLIFIED_EXCEPTION_CODES=y

#
# Security Options
#
CONFIG_EXECUTE_XOR_WRITE=y
# CONFIG_BOUNDS_CHECK_BYPASS_MITIGATION is not set
# end of Security Options


#
# Debugging Options
#
CONFIG_DEBUG=y
CONFIG_STACK_USAGE=y
CONFIG_PRINTK=y
CONFIG_PRINTK_BUFFER_SIZE=32
CONFIG_EARLY_CONSOLE=y
CONFIG_ASSERT=y
CONFIG_ASSERT_LEVEL=2
CONFIG_SPIN_VALIDATE=y
# CONFIG_FORCE_NO_ASSERT is not set
CONFIG_ASSERT_VERBOSE=y
# CONFIG_ASSERT_NO_FILE_INFO is not set
# CONFIG_ASSERT_NO_COND_INFO is not set
# CONFIG_ASSERT_NO_MSG_INFO is not set
# CONFIG_ASSERT_TEST is not set
# CONFIG_OVERRIDE_FRAME_POINTER_DEFAULT is not set
CONFIG_DEBUG_INFO=y
CONFIG_EXCEPTION_STACK_TRACE=y
# CONFIG_DEBUG_THREAD_INFO is not set
# CONFIG_DEBUG_COREDUMP is not set
# end of Debugging Options

#
# Kernel Debugging and Metrics
#
# CONFIG_INIT_STACKS is not set
CONFIG_BOOT_BANNER=y
CONFIG_BOOT_BANNER_STRING="Booting Zephyr OS build"
CONFIG_BOOT_DELAY=0
CONFIG_THREAD_MONITOR=y
CONFIG_THREAD_NAME=y
CONFIG_THREAD_MAX_NAME_LEN=32
# CONFIG_THREAD_RUNTIME_STATS is not set
# end of Kernel Debugging and Metrics

#
# Compiler Options
#
# CONFIG_CODING_GUIDELINE_CHECK is not set
CONFIG_SIZE_OPTIMIZATIONS=n
CONFIG_SPEED_OPTIMIZATIONS=n
CONFIG_DEBUG_OPTIMIZATIONS=n
CONFIG_NO_OPTIMIZATIONS=y
CONFIG_COMPILER_WARNINGS_AS_ERRORS=y
# CONFIG_COMPILER_SAVE_TEMPS is not set
CONFIG_COMPILER_TRACK_MACRO_EXPANSION=y
CONFIG_COMPILER_COLOR_DIAGNOSTICS=y
# CONFIG_FORTIFY_SOURCE_NONE is not set
CONFIG_FORTIFY_SOURCE_COMPILE_TIME=y
# CONFIG_FORTIFY_SOURCE_RUN_TIME is not set
# CONFIG_COMPILER_OPT=""
# CONFIG_MISRA_SANE is not set
# end of Compiler Options

# CONFIG_ASSERT_ON_ERRORS is not set
CONFIG_NO_RUNTIME_CHECKS=n
CONFIG_RUNTIME_ERROR_CHECKS=y
```

## src/main.c
```c
/*
 * Copyright (c) 2024 EmLogic
 * Author: frm@EmLogic.no
 *
 * Licence: LGPLv3+: GNU LGPL version 3 or later
 */

#include <stdio.h>

int main(void)
{
	printf("EmLogic thread demo %s\n", CONFIG_BOARD);
	return 0;
}
```
